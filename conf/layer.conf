## conf/layer.conf
```bitbake
# We have a conf and classes directory, add to BBPATH
BBPATH .= ":${LAYERDIR}"

# We have a recipes-* directories, add to BBFILES
BBFILES += "${LAYERDIR}/recipes-*/*/*.bb \
	${LAYERDIR}/recipes-*/*/*.bbappend"

BBFILE_COLLECTIONS += "multiconfig-demo-layer"
BBFILE_PATTERN_multiconfig-demo-layer = "^${LAYERDIR}/"
BBFILE_PRIORITY_multiconfig-demo-layer = "5"

LAYERSERIES_COMPAT_multiconfig-demo-layer = "dunfell hardknott"
```
